## drivers/staging/imgtec/sgx/Kconfig
```kconfig
config POWERVR_SGX
	tristate "PowerVR SGX"
	default n
	help
	  Driver for PowerVR SGX graphics hardware.

	  Say Y here if your SoC contains a PowerVR SGX GPU. For more
	  information, see <http://www.imgtec.com/powervr/>.

config POWERVR_SGX_PDUMP
	bool "Parameter dumping"
	default n
	depends on POWERVR_SGX

config POWERVR_SGX_TTRACE
	bool "Timed trace support"
	default n
	depends on POWERVR_SGX

config POWERVR_SGX_SYSTRACE
	bool "Systrace support"
	default n
	depends on POWERVR_SGX
	select GPU_TRACEPOINTS
```

## sound/soc/jz4780/Kconfig
```kconfig
config SND_JZ4780_SOC_CI20
	tristate "SoC Audio support for ci20"
	depends on SND_JZ4740_SOC && JZ4780_CI20
	select SND_JZ4740_SOC_I2S
	select SND_SOC_JZ4780_CODEC
	help
	  Say Y if you want to add support for ASoC audio on the ci20.
```
