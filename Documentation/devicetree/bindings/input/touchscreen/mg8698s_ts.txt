## Documentation/devicetree/bindings/input/touchscreen/mg8698s_ts.txt
```
* * mg8698s touchscreen controler

Required properties:
- compatible: must be "tcs,mg8698_tcs"
- reg: I2C address of the chip
- interrupt: interrupt GPIO
- wake-gpio: enable GPIO
- x-size: horizontal resolution of touchscreen
- y-size: vertical resolution of touchscreen

Example:

	i2c@00000000 {
		/* ... */

		mg8698s_ts {
			compatible = "tcs,mg8698_tcs";
			reg = <0x44>;

			wake-gpios = <&gpf 18 GPIO_ACTIVE_LOW>;
			interrupt = <&gpf 19 GPIO_ACTIVE_LOW>;

			x-size = <1344>;
			y-size = <960>;
		};

		/* ... */
	};
```

## Documentation/devicetree/bindings/media/i2c/ov5640.txt
```
Omnivision 5Mp CMOS Digital Image Sensor

The Omnivision OV5640 is a CMOS active pixel digital image sensor with an active
array size of 2592H x 1944V. It is programmable through a simple two-wire serial
interface.

Required Properties:
- compatible: value should be "omnivision,ov5640"
- core-supply: phandle to regulator for core 1.5V
- analog-supply: phandle to regulator for analog 2.8V

Optional Properties:
- gpio-enable: handle to GPIO connected to enable pin
- gpio-reset: handle to GPIO connected to reset pin

For further reading on port node refer to
Documentation/devicetree/bindings/media/video-interfaces.txt.

Example:

	i2c_master {
		ov5640@0x3C {
			compatible = "omnivision,ov5640";
			reg = <0x3C>;

			core-supply = <&vcim1v5_reg>;
			analog-supply = <&vcim2v8_reg>;

			gpio-enable = <&gpb 18 0>;
			gpio-reset = <&gpb 26 0>;

			remote = <&pxa_camera>;
			port {
				ov5640_1: endpoint {
					bus-width = <8>;
					remote-endpoint = <&pxa_camera>;
				};
			};
		};
	};
```

## Documentation/devicetree/bindings/media/jz4780-camera.txt
```
Ingenic JZ4780 camera host interface

Required properties:
- compatible: Should be "ingenic,jz4780-cim"
- reg: register base and size
- interrupts: the interrupt number
- clocks : phandles to the module & baud clocks.
- clock-names: tuple listing input clock names. 
	Required elements: "cim", "module"

Optional properties:
 - clock-frequency: host interface is driving MCLK, and MCLK rate is this rate

For further reading on port node refer to
Documentation/devicetree/bindings/media/video-interfaces.txt.
 
Example:
	cim: jz4780-cim@0x13060000 {
		compatible = "ingenic,jz4780-cim";
		reg = <0x13060000 0x68>;
		reg-shift = <2>;

		interrupt-parent = <&intc>;
		interrupts = <30>;

		pinctrl-names = "default";
		pinctrl-0 = <&pins_cim>;

		clocks = <&cgu JZ4780_CLK_CIM>, <&cgu JZ4780_CLK_CIMMCLK>;
		clock-names = "cim", "module";
		clock-frequency = <24000000>;
		
		port {
		#address-cells = <1>;
		#size-cells = <0>;

		/* Parallel bus endpoint */
		camera: endpoint@0 {
			reg = <0>;		/* Local endpoint # */
			remote-endpoint = <&ov5640_1>;
			hsync-active = <1>;	/* Active high */
			vsync-active = <1>;	/* Active high */
			pclk-sample = <0>;	/* Falling */
		};
	};
	};
```

## Documentation/devicetree/bindings/mfd/ingenic,jz4740-adc.txt
```
* Ingenic JZ4740 ADC

Required properties:
- compatible: should be "ingenic,jz4740-adc"
- reg: Should contain the address & length of registers
- interrupts: Should specify the interrupt provided by parent.
- clocks: Should contain a single clock specifier for the ADC clock.
- clock-names: Should be "adc".

Example:

adc@0x10070000 {
	compatible = "ingenic,jz4740-adc";
	reg = <0x10070000 0x30>;

	interrupt-parent = <&intc>;
	interrupts = <18>;

	clocks = <&cgu JZ4780_CLK_SADC>;
	clock-names = "adc";
};
```

## Documentation/devicetree/bindings/misc/ingenic,jz-efuse.txt
```
Ingenic JZ EFUSE driver bindings

Required properties:
- "compatible"		Must be set to "ingenic,jz4780-efuse"
- "reg"			Register location and length
- "clocks"		Handle for the ahb clock for the efuse.
- "clock-names"		Must be "bus_clk"

Example:

efuse: efuse@134100D0 {
	compatible = "ingenic,jz4780-efuse";
	reg = <0x134100D0 0xFF>;

	clocks = <&cgu JZ4780_CLK_AHB2>;
	clock-names = "bus_clk";
};
```

## Documentation/devicetree/bindings/mmc/jz47xx-mmc.txt
```
* Ingenic JZ47xx MMC controllers

This file documents the device tree properties used for the MMC controller in
Ingenic JZ47xx SoCs. These are in addition to the core MMC properties described
in mmc.txt.

Required properties:
- compatible: Should be one of the following:
  - "ingenic,jz4740-mmc" for the JZ4740
  - "ingenic,jz4780-mmc" for the JZ4780
- reg: Should contain the MMC controller registers location and length.
- interrupts: Should contain the interrupt specifier of the MMC controller.
- clocks: Clock for the MMC controller.

Optional properties:
- vmmc-supply: phandle to regulator handling power for mmc

Examples:

  msc0: msc@13450000 {
    compatible = "ingenic,jz4780-mmc";
    reg = <0x13450000 0x1000>;

    interrupt-parent = <&intc>;
    interrupts = <37>;

    clocks = <&cgu JZ4780_CGU_CLK_MSC0>;

    bus-width = <4>;
    cd-gpios = <&gpf 20 1>;

    vmmc-supply = <&regulator_power>;

  };
```

## Documentation/devicetree/bindings/mtd/ingenic,jz4780-nand.txt
```
* Ingenic JZ4780 NAND/BCH

This file documents the device tree bindings for NAND flash devices on the
JZ4780. NAND devices are connected to the NEMC controller (described in
memory-controllers/ingenic,jz47xx-nemc.txt), and thus NAND device nodes must
be children of the NEMC node.

Required NAND device properties:
- compatible: Should be set to "ingenic,jz4780-nand".
- reg: For each bank with a NAND chip attached, should specify a bank number,
  an offset of 0 and a size of 0x1000000 (i.e. the whole NEMC bank).

Optional NAND device properties:
- ingenic,bch-device: To make use of the hardware BCH controller, this property
  must contain a phandle for the BCH controller node. The required properties
  for this node are described below. If this is not specified, software BCH
  will be used instead.
- ingenic,ecc-size: ECC block size in bytes.
- ingenic,ecc-strength: ECC strength (max number of correctable bits).
- ingenic,busy-gpio: GPIO specifier for the busy pin.
- ingenic,wp-gpio: GPIO specifier for the write protect pin.

Example:

nemc: nemc@13410000 {
	...

	nand: nand@1 {
		compatible = "ingenic,jz4780-nand";
		reg = <1 0 0x1000000>;	/* Bank 1 */

		ingenic,bch-device = <&bch>;
		ingenic,ecc-size = <1024>;
		ingenic,ecc-strength = <24>;

		ingenic,busy-gpio = <&gpa 20 GPIO_ACTIVE_LOW>;
		ingenic,wp-gpio = <&gpf 22 GPIO_ACTIVE_LOW>;
	};
};

The BCH controller is a separate SoC component used for error correction on
NAND devices. The following is a description of the device properties for a
BCH controller.

Required BCH properties:
- compatible: Should be set to "ingenic,jz4780-bch".
- reg: Should specify the BCH controller registers location and length.
- clocks: Clock for the BCH controller.

Example:

bch: bch@134d0000 {
	compatible = "ingenic,jz4780-bch";
	reg = <0x134d0000 0x10000>;

	clocks = <&cgu JZ4780_CLK_BCH>;
};
```

## Documentation/devicetree/bindings/power/jz4780-ac-charger.txt
```
* * jz4780-ac-charger AC charger controller

Required properties:
- compatible: must be "ingenic,jz4780-charger"
- gpio-ac: GPIO which is used to indicate the chargers status
- gpio-charging: GPIO which is used to indicate the charging status

Optional properties:
- ac-name: Name for the charger's power_supply device
- type: Type of the charger

Example:

	charger {
		compatible = "ingenic,jz4780-charger";
		gpio-ac = <&gpa 16 GPIO_ACTIVE_HIGH>;
		gpio-charging = <&gpb 3 GPIO_ACTIVE_LOW>;
	};
```

## Documentation/devicetree/bindings/regulator/act8600-regulator.txt
```
ACT8600 regulator
-------------------

Required properties:
- compatible: "active-semi,act8600"
- reg: I2C slave address

Any standard regulator properties defined in regulator.txt
can be used to configure the single regulator.

The valid names for regulators are:
	DCDC_REG1, DCDC_REG2, DCDC_REG3, SUDCDC_REG4, LDO_REG5,
	LDO_REG6, LDO_REG7, LDO_REG8, LDO_REG9, LDO_REG10, VBUS,
	USB_CHARGER

Example:
--------

	i2c1: i2c@f0018000 {
		pmic: act8600@5a {
			compatible = "active-semi,act8600";
			reg = <0x5a>;

			regulators {
				vcc_1v8_reg: DCDC_REG1 {
					regulator-name = "VCC_1V8";
					regulator-min-microvolt = <1800000>;
					regulator-max-microvolt = <1800000>;
					regulator-always-on;
				};

				vcc_1v2_reg: DCDC_REG2 {
					regulator-name = "VCC_1V2";
					regulator-min-microvolt = <1100000>;
					regulator-max-microvolt = <1300000>;
					regulator-always-on;
				};

				vcc_3v3_reg: DCDC_REG3 {
					regulator-name = "VCC_3V3";
					regulator-min-microvolt = <3300000>;
					regulator-max-microvolt = <3300000>;
					regulator-always-on;
				};

				vddana_reg: LDO_REG1 {
					regulator-name = "VDDANA";
					regulator-min-microvolt = <3300000>;
					regulator-max-microvolt = <3300000>;
					regulator-always-on;
				};

				vddfuse_reg: LDO_REG2 {
					regulator-name = "FUSE_2V5";
					regulator-min-microvolt = <2500000>;
					regulator-max-microvolt = <2500000>;
				};
			};
		};
	};
```

## Documentation/devicetree/bindings/regulator/jz4780-lcr.txt
```
Ingenic JZ4780 SoC Low power Control Register regulator driver

Required properties:
- compatible: "ingenic,jz4780-lcr"
- reg: LCR register address
- regulators: A node that houses a sub-node for each regulator controled by the
  register. Each sub-node is identified using the node's name (or the deprecated
  regulator-compatible property if present), with valid values listed below.
  The content of each sub-node is defined by the standard binding for
  regulators; see regulator.txt.

The valid names for regulators are:

  SCPU, VGU, GPU, GPS

Example:

	lpcr: lcr@0x10000004 {
		compatible = "ingenic,jz4780-lcr";
		reg = <0x10000004 0x4>;
		
		regulators {
			vpu_power: VPU {
			};
			gpu_power: GPU {
			};
			gps_power: GPS {
			};
		};
	};
```

## Documentation/devicetree/bindings/rtc/ingenic,jz4740-rtc.txt
```
* Ingenic jz47XX Real Time Clock

Real Time Clock on Ingenic jz47XX series SoCs

Required properties:
- compatible : Should be "ingenic,jz4740-rtc" or "ingenic,jz4780-rtc"
- reg: Should contain the RTC registers location and length.
- interrupts: Should contain the interrupt specifier of the RTC.

Examples:

  rtc: rtc@10003000 {
    compatible = "ingenic,jz4780-rtc";
    reg = <0x10003000 0x4c>;
    interrupt-parent = <&intc>;
    interrupts = <32>;
  };
```

## Documentation/devicetree/bindings/sound/ingenic,jz4740-i2s.txt
```
Ingenic JZ4740 I2S controller

Required properties:
- compatible : "ingenic,jz4740-i2s"
- reg : I2S registers location and length
- clocks : AIC and I2S PLL clock specifiers.
- clock-names: "aic" and "i2s"

Example:

i2s: i2s@10020000 {
	compatible = "ingenic,jz4740-i2s";
	reg = <0x10020000 0x94>;

	clocks = <&cgu JZ4740_CLK_AIC>, <&cgu JZ4740_CLK_I2SPLL>;
	clock-names = "aic", "i2s";

};
```

## Documentation/devicetree/bindings/sound/ingenic,jz4780-ci20.txt
```
CI20 audio driver

Required properties:
- compatible : "ingenic,ci20-audio"
- ingenic,i2s-controller = phandle of jz4780 i2c controller
- ingenic,codec = phandle of jz4780 codec

Example:

audio: audio-ci20 {
	compatible = "ingenic,ci20-audio";
	ingenic,i2s-controller = <&i2s>;
	ingenic,codec = <&codec>;
};
```

## Documentation/devicetree/bindings/sound/ingenic,jz4780-codec.txt
```
Ingenic JZ4780 Codec controller

Required properties:
- compatible : "ingenic,jz4780-codec"
- reg : codec registers location and length
- clock : I2S PLL clock specifier.
- clock-names: "i2s"

Example:

codec: codec@100200a4 {
	compatible = "ingenic,jz4780-codec";
	reg = <0x100200a4 0x8>;

	clocks = <&cgu JZ4780_CLK_I2SPLL>;
	clock-names = "i2s";

};
```

## Documentation/devicetree/bindings/usb/ingenic,jz4780-ehci.txt
```
Ingenic jz4780 SoC EHCI controller binding

The Ingenic jz4780 SoC includes an EHCI compliant USB host controller
interface for use with USB 2.0 devices.

Required properties:
 - compatible: Should be "ingenic,jz4780-ehci".
 - reg: Should contain the address & size of the EHCI controller registers.
 - interrupt-parent: Should be the phandle of the interrupt controller that
   delivers interrupts to the EHCI block.
 - interrupts: Should specify the interrupt provided by interrupt-parent.
 - clocks: Should contain a single clock specifier for the jz4780 UHC clock.
 - ingenic,vbus-gpio: Should be a gpio-list specifying the GPIO used to drive
   VBUS.

Example SoC include file:

/ {
	ehci: jz4780-ehci@13490000 {
		compatible = "ingenic,jz4780-ehci";
		reg = <0x13490000 0x10000>;

		interrupt-parent = <&intc>;
		interrupts = <20>;

		clocks = <&cgu JZ4780_CLK_UHC>;
	};
};

Example board file:

&ehci {
	ingenic,vbus-gpio = <&gpf 15 0>;
};
```

## Documentation/devicetree/bindings/usb/ingenic,jz4780-otg.txt
```
Ingenic jz4780 SoC OTG controller binding

The Ingenic jz4780 SoC includes an OTG compliant USB host controller
interface for use with USB 1.1 and 2.0 devices.

Required properties:
 - compatible: Should be "ingenic,jz4780-otg".
 - reg: Should contain the address & size of the otg controller registers.
 - interrupts: Should specify the interrupt provided by interrupt-parent.
 - clocks: Should contain two clocks for otg_phy and otg1

Optional properties:
 - interrupt-parent: Should be the phandle of the interrupt controller that
   delivers interrupts to the otg block.


Example SoC include file:

/ {
	otg: jz4780-otg@0x13500000 {
		compatible = "ingenic,jz4780-otg";
		reg = <0x13500000 0x40000>;

		interrupt-parent = <&intc>;
		interrupts = <21>;

		clocks = <&cgu JZ4780_CLK_OTGPHY> <&cgu JZ4780_CLK_OTG1>;
		clock-names = "otg_phy", "otg1";
	};
};
```

## Documentation/devicetree/bindings/usb/ingenic,jz47xx-ohci.txt
```
Ingenic jz47xx SoC OHCI controller binding

The Ingenic jz47xx SoC includes an OHCI compliant USB host controller
interface for use with USB 1.1 devices.

Required properties:
 - compatible: Should be "ingenic,jz4780-OHCI" or "ingenic,jz4740-OHCI"
 - reg: Should contain the address & size of the OHCI controller registers.
 - interrupt-parent: Should be the phandle of the interrupt controller that
   delivers interrupts to the OHCI block.
 - interrupts: Should specify the interrupt provided by interrupt-parent.
 - clocks: Should contain a single clock specifier for the SoC UHC clock.
 - ingenic,vbus-gpio: Should be a gpio-list specifying the GPIO used to drive
   VBUS.

Example SoC include file for jz4780:

/ {
	ohci: jz4780-ohci@0x134a0000 {
		compatible = "ingenic,jz4780-ohci";
		reg = <0x134a0000 0x10000>;

		interrupt-parent = <&intc>;
		interrupts = <5>;

		clocks = <&cgu JZ4780_CLK_UHC>;
		clock-names = "uhc";
	};
};

Example board file:

&ohci {
	ingenic,vbus-gpio = <&gpf 15 0>;
};
```

## Documentation/devicetree/bindings/video/backlight/crd080ti01_40nm01.txt
```
crd080ti01_d0nm01 bindings

Required properties:
  - compatible: "crd080ti01_40nm01-lcd"

Optional properties:
  - right-to-left: Left to right GPIO pin scan direction, 0: right to left, 1: left to right
  - up-to-down: Up to down GPIO pin scan direction, 0: top to bottom, 1: bottom to top
  - mode-select: Mode select GPIO pin, H: 6bit, L: 8bit
  - standby-mode: Stadnby mode GPIO pin, normally pull high. 1: normal operation
  - reset: Global reset GPIO pin, active low to enter reset state
  - left-to-right-scan: Left to right GPIO pin scan direction, 0: right to left, 1: left to right. 1 is default if not specified.
  - bottom-to-top-scan: Up to down GPIO pin scan direction, 0: top to bottom, 1: bottom to top. 1 is default if not specified.
  - six-bit-mode: 6bit/8bit mode select, 1: 6bit, 0: 8bit. 1 is default if not specified.


Example:

	backlight@1 {
		compatible = "crd080ti01_40nm01-lcd";
		reset = <&gpb 22 0>;
	};
```
